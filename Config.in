## Config.in
```kconfig
# links to custom packages
source "$BR2_EXTERNAL_SED_TRAINING_PATH/package/bootgen/Config.in.host"
source "$BR2_EXTERNAL_SED_TRAINING_PATH/package/puka-engine/Config.in"
source "$BR2_EXTERNAL_SED_TRAINING_PATH/package/puka-conf/Config.in"
```

## package/puka-conf/Config.in
```kconfig
  config BR2_PACKAGE_PUKA_CONF
	bool "puka-conf"
	depends on BR2_PACKAGE_OPENSSL
	depends on BR2_PACKAGE_LIBOPENSSL
	help
	  Openssl conf for puka engine usage.
```

## package/puka-engine/Config.in
```kconfig
  config BR2_PACKAGE_PUKA_ENGINE
	bool "puka-engine"
	depends on BR2_TOOLCHAIN_USES_GLIBC
	depends on BR2_TOOLCHAIN_BUILDROOT_LIBC="glibc"
	depends on BR2_TOOLCHAIN_BUILDROOT_GLIBC
	depends on BR2_PACKAGE_OPENSSL
	depends on BR2_PACKAGE_LIBOPENSSL
	depends on BR2_PACKAGE_UTIL_LINUX
	select BR2_PACKAGE_READLINE
	select BR2_PACKAGE_LIBGLIB2
	select BR2_PACKAGE_PUKA_CONF
	help
	  Puka OpenSSL engine for training.
```
